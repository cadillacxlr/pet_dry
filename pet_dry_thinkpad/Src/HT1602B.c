

#include "HT1602B.h"

/*******************************************************************************
                                     延时 us
*******************************************************************************/
void DelayUS(uint16_t us)  //5,7,9 
{ 
	uint16_t i;
	for(i=0;i<us;i++);
} 
/*******************************************************************************
                 写数据函数,cnt为传送数据位数,数据传送为低位在前 
*******************************************************************************/
void Ht1621Wr_Data(uint8_t Data,uint8_t cnt) 
{    
  uint8_t i; 
//==============================================================================    
  for (i=0;i<cnt;i++) 
  {   
    HT1621_WRL; 
    DelayUS(5);
    if(Data&0x80)
      HT1621_DATH;
    else
      HT1621_DATL;
    DelayUS(5);
    HT1621_WRH; 
    DelayUS(5); 
    Data<<=1;  
  } 
} 
/*******************************************************************************
函数名称：void Ht1621WrCmd(uchar Cmd) 
功能描述: HT1621命令写入函数 
全局变量：无 
参数说明：Cmd为写入命令数据 
返回说明：无 
设 计 人：ZHCE 
版    本：1.0 
说    明：写入命令标识位100 
*******************************************************************************/ 
void Ht1621WrCmd(uint8_t Cmd) 
{ 
  HT1621_CSL; 
  DelayUS(5);
  Ht1621Wr_Data(0x80,4);//写入命令标志100 
  Ht1621Wr_Data(Cmd,8);//写入命令数据 
  HT1621_CSH; 
  DelayUS(5);
} 
/*******************************************************************************
                                 时基及测试命令
*******************************************************************************/
void HT1621CMD2(uint8_t Cmd)
{
  HT1621_CSL; 
  DelayUS(5);
  Ht1621Wr_Data(0xa0,4);//写入命令标志100 
  Ht1621Wr_Data(Cmd,8);//写入命令数据 
  HT1621_CSH; 
  DelayUS(5);
}
/*******************************************************************************
函数名称：void Ht1621WrAllData(uint8_t Addr,uint8_t *p,uint8_t cnt) 
功能描述: HT1621连续写入方式函数 
全局变量：无 
参数说明：Addr为写入初始地址，*p为连续写入数据指针，cnt为写入数据总数 
返回说明：无 
设 计 人：ZHCE 
版    本：1.0 
说    明：HT1621的数据位4位，此处每次数据为8位，写入数据总数按8位计算 
*******************************************************************************/ 
void Ht1621WrAllData(uint8_t Addr,uint8_t *p,uint8_t cnt) 
{ 
  uint8_t i; 
//==============================================================================    
  HT1621_CSL; 
  Ht1621Wr_Data(0xa0,3);//写入数据标志101 
  Ht1621Wr_Data(Addr<<2,6);//写入地址数据 
  for (i=0;i<cnt;i++) 
  { 
    Ht1621Wr_Data(*p,8);//写入数据 8
    p++; 
  } 
  HT1621_CSH;   
  DelayUS(3); 
} 
/******************************************************************************
函数名称：void Ht1621_Init(void) 
功能描述: HT1621初始化 
全局变量：无 
参数说明：无 
返回说明：无 
设 计 人：ZHCE 
版    本：1.0 
说    明：初始化后，液晶屏所有字段均显示 
*******************************************************************************/ 
void Ht1621_Init(void) 
{ 
//	HT1621_CSL; 
//  HT1621_WRL; 
//  HT1621_DATL;
	
  HT1621_CSH; 
  HT1621_WRH; 
  HT1621_DATH; 
//  HT1621_RDH;
  HAL_Delay(200);//延时使LCD工作电压稳定 
  Ht1621WrCmd(BIAS); 
  Ht1621WrCmd(RC256); //使用内部振荡器 
  //Ht1621WrCmd(SYSDIS); 
  Ht1621WrCmd(WDTDIS); 
  Ht1621WrCmd(SYSEN); 
  Ht1621WrCmd(LCDON); 
  Ht1621WrCmd(TIMEREN); 
  HT1621CMD2(TEST);
}



/****************************** Display Application ***************************/
/****************************** Display Application ***************************/
/****************************** Display Application ***************************/
/****************************** Display Application ***************************/

uint8_t SEG_Data[16];// = {0xBD,0x0A,0x0A,0xC7};
////					  0,    1,    2,    3,    4,    5,   6,   7,   8,   9,    10,
//uint8_t SEG_0[11] = {0x10, 0x00, 0x10, 0x10, 0x00, 0x10,0x10,0x00,0x10,0x10, 0x00};
//uint8_t SEG_4[11] = {0x11, 0x01, 0x10, 0x01, 0x01, 0x01,0x11,0x01,0x11,0x01, 0x00};
//uint8_t SEG_5[11] = {0x01, 0x00, 0x10, 0x10, 0x11, 0x11,0x11,0x00,0x11,0x11, 0x00};
//uint8_t SEG_6[11] = {0x11, 0x10, 0x11, 0x11, 0x10, 0x01,0x01,0x11,0x11,0x11, 0x00};




